## config/boards/shields/dilemma/Kconfig.defconfig
```kconfig
if SHIELD_DILEMMA_LEFT

    config ZMK_KEYBOARD_NAME
        default "Dilemma"

    config ZMK_SPLIT_BLE_ROLE_CENTRAL
        default y

endif # LEFT



if SHIELD_DILEMMA_LEFT || SHIELD_DILEMMA_RIGHT

    config ZMK_SPLIT
        default y

endif # LEFT RIGHT
```
